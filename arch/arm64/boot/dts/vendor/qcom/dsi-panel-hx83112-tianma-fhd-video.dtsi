&mdss_mdp {
	dsi_hx83112_tianma_fhd_video: qcom,mdss_dsi_hx83112_tianma_fhd_video {
		qcom,mdss-dsi-panel-name ="hx83112_fhd_video_tianma";
		qcom,mdss-dsi-panel-manufacture = "HIMAX";
		qcom,mdss-dsi-panel-version = "DSC";
	
		qcom,mdss-dsi-backlight-version = "WLED";
	
		qcom,mdss-dsi-backlight-manufacture = "WLED";
	
		qcom,mdss-dsi-panel-type = "dsi_video_mode";
	
		qcom,dsi-ctrl-num = <0>;
	
		qcom,dsi-phy-num = <0>;
	
		qcom,mdss-dsi-virtual-channel-id = <0>;
	
		qcom,mdss-dsi-stream = <0>;
	
		qcom,mdss-dsi-bpp = <24>;
	
		qcom,mdss-dsi-border-color = <0>;
	
	
		qcom,mdss-dsi-traffic-mode = "non_burst_sync_event";
	
		qcom,mdss-dsi-bllp-eof-power-mode;
	
		qcom,mdss-dsi-bllp-power-mode;
	
		qcom,mdss-dsi-lane-0-state;
	
		qcom,mdss-dsi-lane-1-state;
	
		qcom,mdss-dsi-lane-2-state;
	
		qcom,mdss-dsi-lane-3-state;
	
		qcom,mdss-dsi-dma-trigger = "trigger_sw";
	
		qcom,mdss-dsi-mdp-trigger = "none";
	
		qcom,mdss-dsi-reset-sequence = <1 5>, <0 5>, <1 5>;
	
		qcom,adjust-timer-wakeup-ms = <1>;
	
		qcom,mdss-dsi-lp11-init;
	
		qcom,mdss-dsi-display-timings {
	
			timing@0 {
	
				qcom,mdss-dsi-panel-framerate = <60>;
	
				qcom,mdss-dsi-panel-width = <1080>;
	
				qcom,mdss-dsi-panel-height = <2400>;
	
				qcom,mdss-dsi-h-front-porch = <52>;
	
				qcom,mdss-dsi-h-back-porch = <70>;
	
				qcom,mdss-dsi-h-pulse-width = <29>;
	
				qcom,mdss-dsi-h-sync-skew = <0>;
	
				qcom,mdss-dsi-v-back-porch = <15>;
	
				qcom,mdss-dsi-v-front-porch = <1300>;
	
				qcom,mdss-dsi-v-pulse-width = <15>;
	
				qcom,mdss-dsi-h-left-border = <0>;
	
				qcom,mdss-dsi-h-right-border = <0>;
	
				qcom,mdss-dsi-v-top-border = <0>;
	
				qcom,mdss-dsi-v-bottom-border = <0>;
	
				qcom,mdss-dsi-on-command = [
					39 01 00 00 00 00 04 b9 83 11 2f
					39 01 00 00 00 00 02 35 00
					39 01 00 00 00 00 05 C9 00 1E 0F E2
					39 01 00 00 00 00 03 b7 00 00
					05 01 00 00 3C 00 01 11
					39 01 00 00 00 00 03 51 FF 0F
					39 01 00 00 00 00 02 53 2c
					39 01 00 00 00 00 02 55 01
					05 01 00 00 14 00 01 29
					39 01 00 00 00 00 02 BD 02
 					39 01 00 00 00 00 03 BF C0 40
 					39 01 00 00 00 00 02 BD 00
					15 01 00 00 00 00 02 BD 03
					39 01 00 00 0A 00 19 E4 8F 80 AA A5 AB B0 C8 DE FF FF FF 03 00 24 28 32 47 50 8D B6 FC FF FF 03
					15 01 00 00 00 00 02 BD 00];
	
	
				qcom,mdss-dsi-off-command = [
					05 01 00 00 20 00 02 28 00
					05 01 00 00 40 00 02 10 00];
	
	
				qcom,mdss-dsi-set-cabc-mode1 = [
					15 01 00 00 06 00 02 55 01
				];
	
	
				qcom,mdss-dsi-set-cabc-mode2 = [
                                        15 01 00 00 06 00 02 55 02
                                ];
	
	
				qcom,mdss-dsi-set-cabc-mode1-state = "dsi_lp_mode";
	
				qcom,mdss-dsi-set-cabc-mode2-state = "dsi_lp_mode";
	
				qcom,mdss-dsi-on-command-state = "dsi_lp_mode";
	
				qcom,mdss-dsi-off-command-state = "dsi_lp_mode";
	
				qcom,mdss-dsi-h-sync-pulse = <0>;
	
				qcom,compression-mode = "dsc";
	
				qcom,mdss-dsc-slice-height = <20>;
	
				qcom,mdss-dsc-slice-width = <540>;
	
				qcom,mdss-dsc-slice-per-pkt = <1>;
	
				qcom,mdss-dsc-bit-per-component = <8>;
	
				qcom,mdss-dsc-bit-per-pixel = <8>;
	
				qcom,mdss-dsc-block-prediction-enable;
	
			};
	
		};
	
	};
	
};