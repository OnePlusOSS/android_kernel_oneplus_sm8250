/dts-v1/;
/plugin/;

#include <dt-bindings/clock/qcom,gcc-kona.h>
#include <dt-bindings/clock/qcom,camcc-kona.h>
#include <dt-bindings/clock/qcom,rpmh.h>
#include <dt-bindings/interrupt-controller/arm-gic.h>

#include "kona-mtp.dtsi"
#include "kebab-oem.dtsi"
#include "kebab.dtsi"
#include "camera/kona-oem-camera-kebab_t0.dtsi" /* camera maybe use the same */
/ {
	model = "Qualcomm Technologies, Inc. kona MTP 19805 20809";
	compatible = "qcom,kona-mtp", "qcom,kona", "qcom,mtp";
	qcom,board-id = <8 0>;
	/*we can add project id to this array,uefi can auto read it,if new project,we add to this array */
	oem,project-id = <19805 20809>;
	/*we can add hw id to this array,uefi can auto read it,if new hw,we add to this array  */
	oem,hw-id = <11 12 13 14 15 51 52 53 54 55>;
};

