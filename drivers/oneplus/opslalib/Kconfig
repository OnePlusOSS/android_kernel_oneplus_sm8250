## drivers/oneplus/opslalib/Kconfig
```kconfig
config SLA
	default n
	bool "to monitor netlink traffic"
	help
	  Realtime netlink traffic monitor.

config SLA_ALGO
	default n
	bool "OnePlus SLA algorithm"
```

## drivers/oneplus/power/Kconfig
```kconfig
# oem device driver for charge
#
source "drivers/oneplus/power/supply/Kconfig"
source "drivers/oneplus/power/oplus_chg/Kconfig"
```

## drivers/oneplus/power/supply/Kconfig
```kconfig
# oem device driver for charge
#
source "drivers/oneplus/power/supply/qcom/Kconfig"
source "drivers/oneplus/power/supply/wlchg/Kconfig"
```

## drivers/oneplus/power/supply/qcom/Kconfig
```kconfig
# oem device driver for charge

config FG_BQ27541
	tristate "TI bq27541 fg"
	depends on I2C
	help
	  Say Y here to enable the TI Fuel Gauge driver.This adds support
	  for battery fuel gauging and state of charge of battery connected to
	  the fuel gauge. The state of charge is reported through a BMS power
	  supply property and also sends uevents when the capacity is updated.

config OP_DEBUG_CHG
	tristate "OP DEBUG CHARGE"
	depends on MFD_SPMI_PMIC
	help
	  Enables support for the debug charging peripheral
	  When use agingboot,can dump pmic register and
	  print vbus vbat current information
	  a

config ONEPLUS_FASTCHG
	tristate "ONEPLUS FAST CHARGE"
	depends on I2C
	help
	  Say Y here to enable the ONEPLUS FAST CHARGE driver.This adds support
	  for WARP charge and state of charge of battery connected to
	  the battery. The state of charge is reported through a battery power
	  supply property

config CP_DA9313
	tristate "Dialog da9313 dual cell switched capacitor divider"
	depends on I2C
	help
	  Say Y here to enable the da9313 divider driver.This adds support
	  for dual cell switched capacitor divider to power system.

config CHGIC_MP2762
	tristate "MPS mp2762 buck and boost charger ic"
	depends on I2C
	help
	  Say Y here to enable the MP2762 buck and boost charger driver.This adds support
	  for dual cell switched capacitor divider to power system.
```

## drivers/oneplus/power/supply/wlchg/Kconfig
```kconfig
# oem device driver for charge

config ONEPLUS_WIRELESSCHG
	tristate "ONEPLUS WIRELESS CHARGE"
	depends on I2C
	help
	  Say Y here to enable the ONEPLUS WIRELESS CHARGE driver.This adds support
	  for wireless charge and state of charge of battery connected to
	  the battery. The state of charge is reported through a battery power
	  supply property
```

## drivers/oneplus/step_motor/Kconfig
```kconfig
config STEP_MOTOR
	tristate "Step motor driver for stspin220"
	help
	  This option enable support for stspin220 step motor Driver.

config DIGITAL_HALL_M1120
	tristate "digital hall m1120 Controler"
	default n
	help
	  Say Y here to enable m1120.
	
config ONEPLUS_STEP_MOTOR
	tristate "config oneplus step motor"
	default n
	help
	  Say Y to enable oneplus step motor.
```

## drivers/oneplus/vl53L1/Kconfig
```kconfig
config STMVL53L1
        tristate "STM VL53L1 Proximity support"
        depends on I2C=y
        default y
        help
          Say Y here if you want to use STMicroelectronics's vl53L1 TOF AF sensor
          through I2C interface.

          To compile this driver as a module, choose M here: the
          module will be called stmvl53l1.
```

## drivers/power/Kconfig
```kconfig
source "drivers/power/avs/Kconfig"
source "drivers/power/reset/Kconfig"
source "drivers/power/supply/Kconfig"

#ifdef OPLUS_FEATURE_CHG_BASIC
config OPLUS_SM8250_CHARGER
	tristate "OPLUS SM8150 charger driver"
	depends on MFD_SPMI_PMIC
	help
	  Enables support for the oplus charging framework

config OPLUS_SM7250R_CHARGER
	tristate "OPLUS SM7250R charger driver"
	depends on MFD_SPMI_PMIC
	help
	  Enables support for the oplus charging framework

config OPLUS_CHARGER_OPTIGA
        bool "OPLUS OPTIGA soc node"
        help
          Say Y to include support

config OPLUS_SHORT_C_BATT_CHECK
	tristate "OPLUS_SHORT_C_BATT CHECK SUPPORT"
	default n
	depends on MFD_SPMI_PMIC
	help
	  Say Y to include support

config OPLUS_CALL_MODE_SUPPORT
	bool "OPLUS call mode support"
	help
	  Say Y to include support

config OPLUS_SMART_CHARGER_SUPPORT
	bool "OPLUS smart charger support"
	help
	  Say Y to include support

config OPLUS_SHORT_HW_CHECK
	tristate "OPLUS_SHORT_HW CHECK SUPPORT"
	default n
	depends on MFD_SPMI_PMIC
	help
	  Say Y to include support

config OPLUS_CHIP_SOC_NODE
	bool "OPLUS chip soc node"
	help
	  Say Y to include support


config OPLUS_SHORT_IC_CHECK
	tristate "OPLUS_SHORT_IC CHECK SUPPORT"
	default n
	depends on MFD_SPMI_PMIC
	help
	  Say Y to include support

config OPLUS_SHORT_USERSPACE
	bool "OPLUS batt userspace"
	help
	 Say Y to include support

config OPLUS_RTC_DET_SUPPORT
	tristate "OPLUS RTC DET SUPPORT"
	default n
	depends on MFD_SPMI_PMIC
	help
	  Say Y to include support

config OPLUS_CHECK_CHARGERID_VOLT
	tristate "OPLUS CHECK CHARGERID VOLT"
	default n
	depends on MFD_SPMI_PMIC
	help
	  Say Y to include support

config OPLUS_SHIP_MODE_SUPPORT
	tristate "OPLUS_SHIP_MODE_SUPPORT"
	default n
	depends on MFD_SPMI_PMIC
	help
	  Say Y to include support
config OPLUS_CHARGER_WIRELESS_PEN
	bool "OPLUS charger wireless pen"
	help
	  Say Y to include support

source "drivers/power/oplus/Kconfig"
#endif
```

## drivers/sensors/Kconfig
```kconfig
# SPDX-License-Identifier: GPL-2.0-only
config SENSORS_SSC
	bool "Enable Sensors Driver Support for SSC"
	help
	  Add support for sensors SSC driver.
	  This driver is used for exercising sensors use case,
	  time syncing with ADSP clock.

config SENSORS_SIMULATED_HALL
	bool "Enable SIMULATED_HALL Driver"
	help
	  Add support for SIMULATED HALL SENSOR.
```

## drivers/soc/Kconfig
```kconfig
menu "SOC (System On Chip) specific Drivers"

source "drivers/soc/actions/Kconfig"
source "drivers/soc/amlogic/Kconfig"
source "drivers/soc/atmel/Kconfig"
source "drivers/soc/bcm/Kconfig"
source "drivers/soc/fsl/Kconfig"
source "drivers/soc/imx/Kconfig"
source "drivers/soc/mediatek/Kconfig"
source "drivers/soc/qcom/Kconfig"
source "drivers/soc/renesas/Kconfig"
source "drivers/soc/rockchip/Kconfig"
source "drivers/soc/samsung/Kconfig"
source "drivers/soc/sunxi/Kconfig"
source "drivers/soc/tegra/Kconfig"
source "drivers/soc/ti/Kconfig"
source "drivers/soc/ux500/Kconfig"
source "drivers/soc/versatile/Kconfig"
source "drivers/soc/xilinx/Kconfig"
source "drivers/soc/zte/Kconfig"
source "drivers/soc/oplus/Kconfig"
#ifdef OPLUS_FEATURE_IOMONITOR
source "drivers/soc/oplus/iomonitor/Kconfig"
#endif /*OPLUS_FEATURE_IOMONITOR*/
#ifdef VENDOR_EDIT
source "drivers/soc/oplus/system/Kconfig"
#endif /* VENDOR_EDIT */
#ifdef OPLUS_FEATURE_HEALTHINFO
source "drivers/soc/oplus/healthinfo/Kconfig"
#endif /* OPLUS_FEATURE_HEALTHINFO */

#ifdef OPLUS_FEATURE_POWERINFO_STANDBY
source "drivers/soc/oplus/owakelock/Kconfig"
#endif /* OPLUS_FEATURE_POWERINFO_STANDBY */

#ifdef OPLUS_FEATURE_SENSOR_SMEM
source "drivers/soc/oplus/sensor/Kconfig"
#endif /* OPLUS_FEATURE_SENSOR_SMEM */

#ifdef OPLUS_FEATURE_ESIM
source "drivers/soc/oplus/misc/Kconfig"
#endif /* OPLUS_FEATURE_ESIM */

#ifdef OPLUS_FEATURE_TPP
#jacky.ho@optimization add for tpp module
source "drivers/soc/oplus/tpp/Kconfig"
#endif /* OPLUS_FEATURE_IM */

#ifdef OPLUS_FEATURE_IM
#ted.lin@optimization add for im module
source "drivers/soc/oplus/im/Kconfig"
#endif /* OPLUS_FEATURE_IM */

#ifdef OPLUS_FEATURE_TPD
source "drivers/soc/oplus/tpd/Kconfig"
#endif

#Add for NandSwap
source "drivers/soc/oplus/oplus_nandswap/Kconfig"

#ifdef OPLUS_FEATURE_GAME_OPT
source "drivers/soc/oplus/game_opt/Kconfig"
#endif /* OPLUS_FEATURE_GAME_OPT */

endmenu
```

## drivers/soc/oplus/Kconfig
```kconfig
#ifdef OPLUS_FEATURE_TP_BASIC
config OPLUS_COMMON_SOFT
  bool "config oplus common software"
  help
        define this config to get project verion from sharemem.
        Maybe this value is from CDT or dynamic identify by hardware
        id.

source "drivers/soc/oplus/device_info/Kconfig"
#endif /* OPLUS_FEATURE_TP_BASIC */


#ifdef OPLUS_FEATURE_GPIO_NC
config OPLUS_GPIO_NC
  bool "config oplus gpio nc"
  help
        define this config to compile oplus_gpio.c for device register
#endif

#ifdef OPLUS_FEATURE_LOWMEM_DBG
#Add for dump memory usage when lowmmem occurs.
source "drivers/soc/oplus/lowmem_dbg/Kconfig"
##endif /* OPLUS_FEATURE_LOWMEM_DBG */

#ifdef OPLUS_FEATURE_MIDAS
source "drivers/soc/oplus/midas/Kconfig"
#endif

#ifdef OPLUS_FEATURE_MEMLEAK_DETECT
#Add for svelte
source "drivers/soc/oplus/svelte/Kconfig"
#endif /* OPLUS_FEATURE_MEMLEAK_DETECT */

#ifdef OPLUS_FEATURE_THERMAL_HORAE
source "drivers/soc/oplus/thermal/Kconfig"
#endif /* OPLUS_FEATURE_THERMAL_HORAE */
```

## drivers/soc/oplus/game_opt/Kconfig
```kconfig
config OPLUS_FEATURE_GAME_OPT
        tristate "game optimization"
        default n
        help
            game optimization support
```

## drivers/soc/oplus/oplus_overload/Kconfig
```kconfig
config OPLUS_FEATURE_ABNORMAL_FLAG
	tristate "abnormal_flag"
	default n
	help
	  abnormal thread detection
```

## fs/f2fs/Kconfig
```kconfig
config F2FS_FS
	tristate "F2FS filesystem support"
	depends on BLOCK
	select NLS
	select CRYPTO
	select CRYPTO_CRC32
	select F2FS_FS_XATTR if FS_ENCRYPTION
	select FS_ENCRYPTION_ALGS if FS_ENCRYPTION
	help
	  F2FS is based on Log-structured File System (LFS), which supports
	  versatile "flash-friendly" features. The design has been focused on
	  addressing the fundamental issues in LFS, which are snowball effect
	  of wandering tree and high cleaning overhead.

	  Since flash-based storages show different characteristics according to
	  the internal geometry or flash memory management schemes aka FTL, F2FS
	  and tools support various parameters not only for configuring on-disk
	  layout, but also for selecting allocation and cleaning algorithms.

	  If unsure, say N.

config F2FS_STAT_FS
	bool "F2FS Status Information"
	depends on F2FS_FS
	default y
	help
	  /sys/kernel/debug/f2fs/ contains information about all the partitions
	  mounted as f2fs. Each file shows the whole f2fs information.

	  /sys/kernel/debug/f2fs/status includes:
	    - major filesystem information managed by f2fs currently
	    - average SIT information about whole segments
	    - current memory footprint consumed by f2fs.

config F2FS_FS_XATTR
	bool "F2FS extended attributes"
	depends on F2FS_FS
	default y
	help
	  Extended attributes are name:value pairs associated with inodes by
	  the kernel or by users (see the attr(5) manual page for details).

	  If unsure, say N.

config F2FS_FS_POSIX_ACL
	bool "F2FS Access Control Lists"
	depends on F2FS_FS_XATTR
	select FS_POSIX_ACL
	default y
	help
	  Posix Access Control Lists (ACLs) support permissions for users and
	  groups beyond the owner/group/world scheme.

	  If you don't know what Access Control Lists are, say N

config F2FS_FS_SECURITY
	bool "F2FS Security Labels"
	depends on F2FS_FS_XATTR
	help
	  Security labels provide an access control facility to support Linux
	  Security Models (LSMs) accepted by AppArmor, SELinux, Smack and TOMOYO
	  Linux. This option enables an extended attribute handler for file
	  security labels in the f2fs filesystem, so that it requires enabling
	  the extended attribute support in advance. In particular you need this
	  option if you use the setcap command to assign initial process capabi-
	  lities to executables (the security.* extended attributes).

	  If you are not using a security module, say N.

config F2FS_CHECK_FS
	bool "F2FS consistency checking feature"
	depends on F2FS_FS
	help
	  Enables BUG_ONs which check the filesystem consistency in runtime.

	  If you want to improve the performance, say N.

config F2FS_FS_ENCRYPTION
	bool "F2FS Encryption"
	depends on F2FS_FS
	select FS_ENCRYPTION
	help
	  This kconfig symbol is deprecated; now it just selects
	  FS_ENCRYPTION.  Use CONFIG_FS_ENCRYPTION=y in new config
	  files.

config F2FS_IO_TRACE
	bool "F2FS IO tracer"
	depends on F2FS_FS
	depends on FUNCTION_TRACER
	help
	  F2FS IO trace is based on a function trace, which gathers process
	  information and block IO patterns in the filesystem level.

	  If unsure, say N.

config F2FS_FAULT_INJECTION
	bool "F2FS fault injection facility"
	depends on F2FS_FS
	help
	  Test F2FS to inject faults such as ENOMEM, ENOSPC, and so on.

	  If unsure, say N.

config F2FS_BD_STAT
	bool "F2FS Bigdata Statisitics Information"
	depends on F2FS_FS
	default n
	help
	  contains the f2fs big-data statistics information about specific partition
	  mounted as f2fs.
	  /proc/fs/f2fs/<partition>/base_info:
	    - basic statistics information
	  /proc/fs/f2fs/<partition>/discard_info
	    - discard statistics information
	  /proc/fs/f2fs/<partition>/cp_info
	    - checkpoint statistics information
	  /proc/fs/f2fs/<partition>/gc_info
	    - gc statistics information
	  /proc/fs/f2fs/<partition>/fsync_info
	    - fsync statistics information
	  /proc/fs/f2fs/<partition>/hotcold_info
	    - hot/cold statistics information

config OPLUS_FEATURE_OF2FS
	bool "OF2FS independent repo"
	depends on F2FS_FS
	default n
	help
	  define this config to switch f2fs repo.

config F2FS_GRADING_SSR
	bool "F2FS grading ssr"
	depends on F2FS_FS
	default n
	help
	  use grading ssr to improve the end performance

config F2FS_FS_COMPRESSION
	bool "F2FS compression feature"
	depends on F2FS_FS
	help
	  Enable filesystem-level compression on f2fs regular files,
	  multiple back-end compression algorithms are supported.

config F2FS_FS_COMPRESSION_FIXED_OUTPUT
	bool "F2FS compression feature (fixed output)"
	depends on F2FS_FS_COMPRESSION
	default y
	help
	  Enable fixed-output compression.

config F2FS_FS_LZO
	bool "LZO compression support"
	depends on F2FS_FS_COMPRESSION
	select LZO_COMPRESS
	select LZO_DECOMPRESS
	default y
	help
	  Support LZO compress algorithm, if unsure, say Y.

config F2FS_FS_LZ4
	bool "LZ4 compression support"
	depends on F2FS_FS_COMPRESSION
	select LZ4_COMPRESS
	select LZ4_DECOMPRESS
	default y
	help
	  Support LZ4 compress algorithm, if unsure, say Y.

config F2FS_FS_LZ4HC
	bool "LZ4HC compression support"
	depends on F2FS_FS_COMPRESSION
	depends on F2FS_FS_LZ4
	select LZ4HC_COMPRESS
	default y
	help
	  Support LZ4HC compress algorithm, LZ4HC has compatible on-disk
	  layout with LZ4, if unsure, say Y.

config F2FS_FS_ZSTD
	bool "ZSTD compression support"
	depends on F2FS_FS_COMPRESSION
	select ZSTD_COMPRESS
	select ZSTD_DECOMPRESS
	default y
	help
	  Support ZSTD compress algorithm, if unsure, say Y.

config F2FS_APPBOOST
       bool
       default y
       help
         Enable Appboost.

config F2FS_FS_DEDUP
	bool "F2FS dedup feature"
	depends on F2FS_FS
	default y
	help
	  Enable the file dedup function.
```

## kernel/Kconfig
```kconfig
# SPDX-License-Identifier: GPL-2.0-only
# Copyright (C) 2018-2020 Oplus. All rights reserved.

source "kernel/sigkill_diagnosis/Kconfig"
```

## mm/damon/Kconfig
```kconfig
# SPDX-License-Identifier: GPL-2.0-only

menu "Data Access Monitoring"

config DAMON
	bool "DAMON: Data Access Monitoring Framework"
	default y

config DAMON_PADDR
	bool "Data access monitoring operations for the physical address space"
	depends on DAMON && MMU
	select PAGE_IDLE_FLAG
	default y

config DAMON_RECLAIM
	bool "Build DAMON-based reclaim (DAMON_RECLAIM)"
	depends on DAMON_PADDR
	default y

endmenu
```

## net/oplus_connectivity_routerboost/Kconfig
```kconfig
# SPDX-License-Identifier: GPL-2.0-only
# Copyright (C) 2020-2022 Oplus. All rights reserved.

config OPLUS_FEATURE_WIFI_ROUTERBOOST
	tristate "Add for oplus routerboost function"
	help
	  Add for oplus routerboost function.
```
