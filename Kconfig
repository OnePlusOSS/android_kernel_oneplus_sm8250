## drivers/block/zram/Kconfig
```kconfig
# SPDX-License-Identifier: GPL-2.0
config ZRAM
	tristate "Compressed RAM block device support"
	depends on BLOCK && SYSFS && ZSMALLOC && CRYPTO
	select CRYPTO_LZO
	default n
	help
	  Creates virtual block devices called /dev/zramX (X = 0, 1, ...).
	  Pages written to these disks are compressed and stored in memory
	  itself. These disks allow very fast I/O and compression provides
	  good amounts of memory savings.

	  It has several use cases, for example: /tmp storage, use as swap
	  disks and maybe many more.

	  See Documentation/blockdev/zram.txt for more information.

config ZRAM_DEDUP
	bool "Deduplication support for ZRAM data"
	depends on ZRAM
	default n
	help
	  Deduplicate ZRAM data to reduce amount of memory consumption.
	  Advantage largely depends on the workload. In some cases, this
          option reduces memory usage to the half. However, if there is no
	  duplicated data, the amount of memory consumption would be
	  increased due to additional metadata usage. And, there is
	  computation time trade-off. Please check the benefit before
	  enabling this option. Experiment shows the positive effect when
	  the zram is used as blockdev and is used to store build output.

config ZRAM_WRITEBACK
       bool "Write back incompressible or idle page to backing device"
       depends on ZRAM
       default n
       help
	 With incompressible page, there is no memory saving to keep it
	 in memory. Instead, write it out to backing device.
	 For this feature, admin should set up backing device via
	 /sys/block/zramX/backing_dev.

	 With /sys/block/zramX/{idle,writeback}, application could ask
	 idle page's writeback to the backing device to save in memory.

	 See Documentation/blockdev/zram.txt for more information.

config ZRAM_MEMORY_TRACKING
	bool "Track zRam block status"
	depends on ZRAM && DEBUG_FS
	help
	  With this feature, admin can track the state of allocated blocks
	  of zRAM. Admin could see the information via
	  /sys/kernel/debug/zram/zramX/block_state.

	  See Documentation/blockdev/zram.txt for more information.

#ifdef OPLUS_FEATURE_ZRAM_OPT
config OPLUS_ZRAM_OPT
	bool "oplus zram  optimization"
	depends on ZRAM
	default y
	help
	oplus zram optimization
#endif /*OPLUS_FEATURE_ZRAM_OPT*/

#ifdef OPLUS_FEATURE_ZRAM_WRITEBACK
source "drivers/block/zram/zwb_handle/Kconfig"
#endif /* OPLUS_FEATURE_ZRAM_WRITEBACK */

config HYBRIDSWAP
	bool "Enable Hybridswap"
	depends on MEMCG && ZRAM && !ZRAM_DEDUP && !ZRAM_WRITEBACK && !ZWB_HANDLE
	default n
	help
	  Hybridswap is a intelligent memory management solution.

config HYBRIDSWAP_SWAPD
	bool "Enable hybridswap swapd thread to reclaim anon pages in background"
	default n
	depends on HYBRIDSWAP
	help
	  swapd is a kernel thread that reclaim anonymous pages in the
	  background. When the use of swap pages reaches the watermark
	  and the refault of anonymous pages is high, the content of
	  zram will exchanged to eswap by a certain percentage.

# Selected when system need hybridswap container
config HYBRIDSWAP_CORE
	bool "Hybridswap container device support"
	depends on ZRAM && HYBRIDSWAP
	default n
	help
	  Say Y here if you want to use the hybridswap
	  as the backend device in ZRAM.
	  If unsure, say N here.
	  This module can't be compiled as a module,
	  the module is as one part of the ZRAM driver.

config HYBRIDSWAP_ASYNC_COMPRESS
	bool "hypbridswap support asynchronous compress anon pages"
	depends on ZRAM && HYBRIDSWAP
	default n
	help
	  Say Y here if you want to create asynchronous thread
	  for compress anon pages.
	  If unsure, say N here.
	  This feature will reduce the kswapd cpu load.
```

## drivers/misc/cs_press/Kconfig
```kconfig
config CS_F61_NDT
	bool "chip sea F61 press sensor"
	default n
	help
	  Say Y here if you have a cs press connected
	  to your system.

	  If unsure, say N.
```

## drivers/nfc/qti/Kconfig
```kconfig
#
# Qcom qti NFC Nci protocol (I2C) devices
#

config NFC_QTI_I2C
	bool "Qcom qti NFC NCI protocol driver (I2C) devices for SNxxx."
	default y
	---help---
	  You'll have to say Y if your computer contains an I2C device that
	  you want to use under Linux.

	  You can say N here if you don't have any I2C connected to your computer.
```

## drivers/oneplus/Kconfig
```kconfig
source "drivers/oneplus/coretech/Kconfig"
source "drivers/oneplus/input/Kconfig"
source "drivers/oneplus/fs/Kconfig"
source "drivers/oneplus/kernel/Kconfig"
source "drivers/oneplus/misc/Kconfig"
#source "drivers/oneplus/step_motor/Kconfig"
#source "drivers/oneplus/tri_state_key/Kconfig"
#source "drivers/oneplus/vibrator/Kconfig"
source "drivers/oneplus/power/Kconfig"
source "drivers/oneplus/vibrator/Kconfig"
#source "drivers/oneplus/power/Kconfig"
source "drivers/oneplus/oneplus_healthinfo/Kconfig"
source "drivers/oneplus/mm/Kconfig"
source "drivers/oneplus/opslalib/Kconfig"
#source "drivers/oneplus/framework/Kconfig"
source "drivers/oneplus/vl53L1/Kconfig"
source "drivers/oneplus/op_freezer/Kconfig"
source "drivers/oneplus/hung_task_enhance/Kconfig"
```

## drivers/oneplus/framework/Kconfig
```kconfig
config DYNAMIC_PAGE_POOL
	default n
	bool "Dynamic Page Pool"
	help
	 Dynamic Page Pool is pre-allocated zeroed pages and will be used
         for anon allocation. This brings improvements in launch latencies
         where anon allocation are significant.
```

## drivers/oneplus/fs/Kconfig
```kconfig
# oem device deriver
source "drivers/oneplus/fs/proc/Kconfig"
source "drivers/oneplus/fs/f2fs/Kconfig"
```

## drivers/oneplus/fs/f2fs/Kconfig
```kconfig
config F2FS_BD_STAT
	bool "F2FS Bigdata Statisitics Information"
	depends on F2FS_FS
	default y
	help
	  contains the f2fs big-data statistics information about specific partition
	  mounted as f2fs.
	  /proc/fs/f2fs/<partition>/base_info:
	  - basic statistics information
	  /proc/fs/f2fs/<partition>/discard_info
	  - discard statistics information
	  /proc/fs/f2fs/<partition>/cp_info
	  - checkpoint statistics information
	  /proc/fs/f2fs/<partition>/gc_info
	  - gc statistics information
	  /proc/fs/f2fs/<partition>/fsync_info
	  - fsync statistics information
	  /proc/fs/f2fs/<partition>/hotcold_info
	  - hot/cold statistics information
```

## drivers/oneplus/fs/proc/Kconfig
```kconfig
config ONEPLUS_FG_OPT
	bool "Enable /proc/fg_info/ if EXPERT"
	default y
	help
	  Add foreground process optimize support to promote performance .
```

## drivers/oneplus/hung_task_enhance/Kconfig
```kconfig
config HUNG_TASK_ENHANCE
	bool "hung task enhance"
	default n
	depends on DETECT_HUNG_TASK
	help
      define this config to enable HUNG_TASK_ENHANCE .
```

## drivers/oneplus/input/Kconfig
```kconfig
# oem device deriver
source "drivers/oneplus/input/touchscreen/Kconfig"
source "drivers/oneplus/input/fingerprint/Kconfig"
```

## drivers/oneplus/input/fingerprint/Kconfig
```kconfig
menuconfig INPUT_FINGERPRINT
	bool "Fingerprint"
	default y
	help
	  Say Y here, and a list of supported fingerprint will be displayed.
	  This option doesn't affect the kernel.

	  If unsure, say Y.

if INPUT_FINGERPRINT

config FINGERPRINT_DETECT
	tristate "fingerprint detect support"
	depends on SPI_MASTER


config FINGERPRINT_GOODIX
	tristate "goodix fingerprint sensor support"
	depends on SPI_MASTER
endif
```

## drivers/oneplus/input/touchscreen/Kconfig
```kconfig
source "drivers/oneplus/input/touchscreen/util_interface/Kconfig"
source "drivers/oneplus/input/touchscreen/samsung/Kconfig"
source "drivers/oneplus/input/touchscreen/synaptics/Kconfig"
```

## drivers/oneplus/input/touchscreen/samsung/s6sy761/Kconfig
```kconfig
config TOUCHPANEL_SAMSUNG_S6SY761
	default y
	bool "TP Samsung s6sy761 IC enable or not for oem"
	---help---
	say Y to enable driver for Touchpanel using Samsung s6sy761
	
config TOUCHPANEL_SAMSUNG
	default y
	bool "TP Samsung IC enable or not for oem"
	---help---
	say Y to enable driver for Touchpanel using Samsung
```

## drivers/oneplus/input/touchscreen/synaptics/syna_tcm_oncell/Kconfig
```kconfig
#
# Synaptics TCM touchscreen driver configuration
#
config TOUCHPANEL_SYNAPTICS_TCM_ONCELL
	default y
	bool "TP IC enable or not for oem"
	---help---
	say Y to enable driver for Touchpanel
```

## drivers/oneplus/kernel/Kconfig
```kconfig
config PANIC_FLUSH
	bool "flush blk device in panic flow"
	default y
	help
	  add flush behaviour in panic flow
	  also contains the blk_issue_flush statistics information
	  /proc/sysctl/blkdev_issue_flush_count
# oem device deriver
source "drivers/oneplus/kernel/cgroup/Kconfig"
```

## drivers/oneplus/kernel/cgroup/Kconfig
```kconfig
config CGROUP_IOLIMIT
	bool "limit controller"
	default n
	help
	  This feature lets vfs recognize task groups and control IO
	  bandwidth allocation to such task groups. It uses cgroups to group
	  tasks.
```

## drivers/oneplus/misc/Kconfig
```kconfig
config OEM_FORCE_DUMP
	default n
	bool "OEM force dump function, it will enable goto the force dump"

config PARAM_READ_WRITE
	bool "Param partition read/write support"
	default n
	help
		if you want to read/write the param partition in kernel,
		then you must say Y here.
config PROJECT_INFO
    bool "detect project info"
    default n
    help
      detect projcet info  If unsure, say n.

config OEM_BOOT_MODE
    bool "detect oem boot mode"
    default n
    help
        detect oem boot mode  If unsure, say y.

config RF_CABLE_DETECT
    bool "detect RF cable connection"
    help
      detect RF cable connection for different RF configuration
      To compile this driver as a module, choose M here: the module
      will be called RF cable.
      If unsure, say N.

config PSTORE_DEVICE_INFO
    bool "Log user space messages"
    depends on PSTORE
    help
      add device_info.txt for ramdump.

      If unsure, say N.
	  
config BOOTLOADER_LOG
	tristate "show bootloader log"
	depends on OF
	default y
	help
	  show bootloader log in kernel

config WB_KERNEL_LOG
	tristate "reserve kernel log to partition driver"
	default n


config GPIO_SWITCH
	tristate "use gpio swith"
	default y
	help
	  we can use gpio switch set gpio out high or low

config REGULATOR_DEMO
	tristate "use regultor demo"
	default y
	help
	  we can use regulator demo to control regulator
```

## drivers/oneplus/mm/Kconfig
```kconfig
config ONEPLUS_MEM_MONITOR
	bool "memory monitor "
	default n
	help
	 memory monitor.
```

## drivers/oneplus/oneplus_healthinfo/Kconfig
```kconfig
config ONEPLUS_HEALTHINFO
	default n
	bool "config oneplus healthinfo"
	help
	  define this config to init oneplus healthinfo.
config ONEPLUS_TASKLOAD_INFO
	bool "config oneplus healthinfo"
	depends on ONEPLUS_HEALTHINFO
	default y
	help
	  define this config to init oneplus taskload info.
```

## drivers/oneplus/op_freezer/Kconfig
```kconfig
config OP_FREEZER
	bool "op_freezer kernel and freezer native communication channel"
	default n
	help
	Key events (signal/network package/binder) report to freezer native.
```
